// SPDX-License-Identifier: GPL-2.0-only
/*
 * Copyright (c) 2022 Qualcomm Innovation Center, Inc. All rights reserved.
 */

&tlmm {
	qupv3_se10_2uart_default: qupv3_se10_2uart_default {
		pins = "gpio46", "gpio47";
		function = "qup1_se3";
	};
};
